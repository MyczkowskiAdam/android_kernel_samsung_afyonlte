## drivers/smeco/Kconfig
```kconfig
#
# Smeco Linux Kernel Module Configuration file
#

menuconfig SMECO
	tristate "Shared Memory IPC support (SMeCo / SMC)"
	default y
	---help---
	The Shared Memory IPC (SMeCo) is used between APE and Modem.

if SMECO

config SMECO_L2MUX
	boolean "Use L2MUX in SMeCo / SMC"
	default y

config SMECO_CONTROL
	boolean "Use SMeCo / SMC Control Instance"
	default n
	---help---
	If this is selected the SMC control channels between CPUs are taken in use

if SMECO_CONTROL
	config SMECO_CONTROL_USE_PHONET
	    boolean "Use Phonet protocol in SMC Control"
	    default y
	     ---help---
		If this is selected the SMC control uses phonet protocol for communication
endif
	
config SMECO_TEST
	boolean "SMeCo SMC Test Features"
	default n
	---help---
	If this option is selected the SMeCo test cases are built in the package.

if SMECO_TEST

	config SMECO_TRACES_ENABLED
	boolean "Activate SMeCo / SMC traces"
	default n

	if SMECO_TRACES_ENABLED
		config SMECO_TRACES_KERN_ALERT
			boolean "Print SMeCo/SMC traces in KERN_ALERT mode"
			default n
			 ---help---
			If this is selected the SMC traces are printed in KERN_ALERT mode
				
		config SMECO_RUNTIME_TRACES_ENABLED
			boolean "Activate SMeCo / SMC runtime R&D traces"
			default n
			---help---
			If this is selected the SMC runtime traces are enabled and can be activated using IOCTL
		
		config SMECO_STM_TRACES_ENABLED
			boolean "Activate SMeCo / SMC STM traces"
			default n
			---help---
			If this is selected the SMC STM traces are enabled
	endif

	config SMECO_ENABLE_DRIVER_SELF
			boolean "Enable SMeCo / SMC driver by itself (NOTE: Only for early test phase use!)"
			default n
			---help---
			Enables SMC device by initializing channels and SHM area. NOTE: Use this only for early phase testing purposes.


	config SMECO_INITIALIZE_DRIVER_SELF
			boolean "Initialize SMeCo / SMC driver by itself"
			default n
	
	if SMECO_INITIALIZE_DRIVER_SELF
	
		config SMECO_INSTANTIATE_DRIVER_SELF
			boolean "Instantiate SMeCo / SMC driver by itself (Only for EOS2)"
			default n
			---help---
			Instantiates the SMC driver resources. NOTE: Works only with EOS2!		
		
	endif

	config SMECO_TEST_MODULE
		boolean "SMeCo SMC Test Module"
		default n
		---help---
		If this option is selected the SMeCo test application module is built in the package.
endif


endif
```

## drivers/staging/lowmemsnpr/Kconfig
```kconfig
config LOW_MEM_SNPR
	bool "Low Memory Sniper"
	default n
	---help---
	  Register processes to be killed when memory is low

config LOW_MEM_SNPR_MIN_FREE_ZERO_BASE
	bool "minimum number of free pages base size"
	default n

config LOW_MEM_SNPR_MIN_FREE_OFFSET
	int "minimum number of free pages"
	default  2048 if !LOW_MEM_SNPR_MIN_FREE_ZERO_BASE
	default 16640 if LOW_MEM_SNPR_MIN_FREE_ZERO_BASE
	---help---
	  17920 pages 70MB
	  16640 pages 65MB

config LOW_MEM_SNPR_TIMEOUT
	int "multiple of HZ (default 2 HZ)"
	default 2

config LOW_MEM_SNPR_DEFAULT
	bool "Low Memory Sniper for added tasks"
	default n
	---help---
	  Register processes to be killed when memory is low

config LOW_MEM_SNPR_RTDS
	bool "Low Memory Sniper for RTDS tasks"
	default n
	---help---
	  Register processes to be killed when memory is low

config LOW_MEM_SNPR_RTDS_SIZE
	bool "Low Memory Sniper kill biggest RTDS task"
	default n
	---help---
	  Low Memory Sniper kill biggest RTDS task

config LOW_MEM_SNPR_LOG_SIGKILL
	string 
	default "sigkill"
```

## drivers/thermal/thermal_sensor/Kconfig
```kconfig
menu "Temperature module (Renesas)"
config THERMAL_SENSOR
	bool "Enable Thermal Sensor driver"
	depends on ARCH_SHMOBILE
	default n
	help
	  Temperature module is used to measure temperature inside LSI.
	  It also has some temperature control methods (such as using DFS,
	  stopping CPU1, raising a software power-on reset). For using these
	  methods, please enable corresponding macros.

	menu "Select temperature control method"
	depends on THERMAL_SENSOR

	config THS_DFS
		bool "Enable DFS"
		default y
		help
		  Enable DFS for temperature control (Limit maximum frequency of CPU0).

	config THS_CPU_HOTPLUG
		bool "Enable CPU_HOTPLUG"
		default y
		help
		  Enable CPU_HOTPLUG for temperature control (Stop CPU1).

	config THS_RESET
		bool "Enable Reset"
		default y
		help
		  Enable software power-on reset for temperature control.

	endmenu

config THS_DEBUG_ENABLE
	bool "Debug information for Thermal Sensor driver"
	depends on THERMAL_SENSOR
	default n
	help
		This config helps to print debug information in terminal.

endmenu
```

## drivers/video/r-mobile/Kconfig
```kconfig
config FB_SH_MOBILE_LCDC
        tristate "SuperH Mobile LCDC framebuffer support"
        depends on FB && (SUPERH || ARCH_SHMOBILE) && HAVE_CLK
        select FB_SYS_FILLRECT
        select FB_SYS_COPYAREA
        select FB_SYS_IMAGEBLIT
        select FB_SYS_FOPS
        select FB_DEFERRED_IO
        select FB_BACKLIGHT
        select SH_MIPI_DSI if SH_LCD_MIPI_DSI
        ---help---
          Frame buffer driver for the on-chip SH-Mobile LCD controller.

choice
        depends on FB_SH_MOBILE_LCDC
        prompt "LCD panel select"

config FB_R_MOBILE_NT35510
        boolean "NT35510 PANEL(COMMAND MODE)"

config FB_R_MOBILE_VX5B3D
        boolean "VX5B3D PANEL(VIDEO MODE)"

config FB_R_MOBILE_HX8389B
        boolean "HX8389B PANEL(VIDEO MODE)"

endchoice

choice
        depends on FB_R_MOBILE_HX8389B || FB_R_MOBILE_NT35510
        prompt "ESD detect method"
        optional

config FB_LCD_ESD
        boolean "LCD ESD RECOVERY by interrupt"

config LCD_ESD_RECOVERY_BY_CHECK_REG
        boolean "LCD ESD RECOVERY by checking register"

endchoice
choice
        depends on FB_SH_MOBILE_LCDC
        prompt "hdmi select"
        default FB_R_MOBILE_HDMI_KOTA
        help
          Selected hdmi

config FB_R_MOBILE_HDMI_KOTA
        boolean "KOTA HDMI"

endchoice

config LDI_MDNIE_SUPPORT
	bool "LDI_MDNIE_SUPPORT"
	help
   	  LDI_MDNIE_SUPPORT

config FB_SH_MOBILE_DOUBLE_BUF
        bool "SuperH Mobile double buffer support"
        depends on FB_SH_MOBILE_LCDC
        default y
        help
          SuperH Mobile LCDC framebuffer support double buffer.

config FB_SH_MOBILE_RGB888
        bool "SuperH Mobile RGB888 support"
        depends on FB_SH_MOBILE_LCDC
        default n
        help
          SuperH Mobile LCDC framebuffer support RGB888.
```

## sound/soc/sh/Kconfig
```kconfig
menu "SoC Audio support for SuperH"
	depends on SUPERH || ARCH_SHMOBILE

config SND_SOC_PCM_SH7760
	tristate "SoC Audio support for Renesas SH7760"
	depends on CPU_SUBTYPE_SH7760 && SH_DMABRG
	help
	  Enable this option for SH7760 AC97/I2S audio support.


##
## Audio unit modules
##

config SND_SOC_SH4_HAC
	tristate
	select AC97_BUS
	select SND_SOC_AC97_BUS

config SND_SOC_SH4_SSI
	tristate

config SND_SOC_SH4_FSI
	tristate "SH4 FSI support"
	help
	  This option enables FSI sound support

config SND_SOC_SH4_SIU
	tristate
	depends on (SUPERH || ARCH_SHMOBILE) && HAVE_CLK
	select DMA_ENGINE
	select DMADEVICES
	select SH_DMAE
	select FW_LOADER

config SND_SOC_AUDIO_TEST_D2153
	tristate

config SND_SOC_AUDIENCE_A2220
	tristate "AUDIENCE-A2220 sound support"
	depends on I2C

config SND_SOC_FM34_WE395
	tristate "Forte Media 2MIC driver"
	depends on I2C
	help
	  This is Forte media voice solution devices.

config SND_SOC_TI_TPA2026
	tristate "TI-TPA2026 sound support"
	depends on I2C
	help
	  This is TPA2026 amp driver.

##
## Boards
##

config SND_SH7760_AC97
	tristate "SH7760 AC97 sound support"
	depends on CPU_SUBTYPE_SH7760 && SND_SOC_PCM_SH7760
	select SND_SOC_SH4_HAC
	select SND_SOC_AC97_CODEC
	help
	  This option enables generic sound support for the first
	  AC97 unit of the SH7760.

config SND_FSI_AK4642
	tristate "FSI-AK4642 sound support"
	depends on SND_SOC_SH4_FSI && I2C
	select SND_SOC_AK4642
	help
	  This option enables generic sound support for the
	  FSI - AK4642 unit

config SND_FSI_DA7210
	tristate "FSI-DA7210 sound support"
	depends on SND_SOC_SH4_FSI && I2C
	select SND_SOC_DA7210
	help
	  This option enables generic sound support for the
	  FSI - DA7210 unit

config SND_FSI_D2153
	tristate "FSI-D2153 sound support"
	depends on SND_SOC_SH4_FSI && I2C
	select SND_SOC_D2153
	select SND_SOC_AUDIO_TEST_D2153
	help
	  This option enables generic sound support for the
	  FSI - d2153 unit

config SND_FSI_HDMI
	tristate "FSI-HDMI sound support"
	depends on SND_SOC_SH4_FSI && FB_SH_MOBILE_HDMI
	help
	  This option enables generic sound support for the
	  FSI - HDMI unit

config SND_SIU_MIGOR
	tristate "SIU sound support on Migo-R"
	depends on SH_MIGOR
	select SND_SOC_SH4_SIU
	select SND_SOC_WM8978
	help
	  This option enables sound support for the SH7722 Migo-R board

endmenu
```
