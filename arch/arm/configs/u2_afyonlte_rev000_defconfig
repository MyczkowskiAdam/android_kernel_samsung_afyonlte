## arch/arm/mach-shmobile/Kconfig.sec
```kconfig
comment "Debugging Feature"
menuconfig SEC_DEBUG
	bool "Samsung TN Ramdump Feature"
	default y
	help
	  Samsung TN Ramdump Feature. Use INFORM3 and magic number at 0xc0000000.

if SEC_DEBUG
config SEC_DEBUG_SCHED_LOG
	bool "Samsung Scheduler Logging Feature"
	default n
	help
	  Samsung Scheduler Logging Feature for Debug use.

config SEC_DEBUG_HRTIMER_LOG
	bool "Samsung hrtimer Logging Feature"
	default n
	depends on SEC_DEBUG_SCHED_LOG && !SAMSUNG_PRODUCT_SHIP
	help
	  Samsung hrtimer Logging Feature for Debug use.
	  This option enables us to log hrtimer enter/exit.

config SEC_DEBUG_SOFTIRQ_LOG
	bool "Samsung Softirq Logging Feature"
	default n
	depends on SEC_DEBUG_SCHED_LOG
	help
	  Samsung Softirq Logging Feature for Debug use.
	  This option enables us to log softirq enter/exit.
	  It is not only hard-irq which results in scheduler lockup,
	  To be more clear we need to see also softirq logs.

config SEC_DEBUG_SCHED_LOG_NONCACHED
	bool "Samsung Scheduler Logging on noncached buf"
	depends on SEC_DEBUG_SCHED_LOG
	default n
	help
	  This option enables sec_debug_sched_log_noncached support.
	  It can support non-cached sched log in RAM dump and We don't
	  need to concern cache flush status for analyzing sudden
	  lockup issue.

config SEC_DEBUG_SEMAPHORE_LOG
	bool "Samsung Semaphore Logging Feature"
	default n
	help
	  Samsung Semaphore Logging Feature for Debug use.

config SEC_DEBUG_USER
	bool "Panic on Userspace fault"
	default y
	help
	  Panic on Userspace fault

config SEC_DEBUG_PM_TEMP
	bool "Temporary Logging for Sleep/Wakeup Issue"
	default n
	help
	  Verbose Log on Sleep/Wakeup.

config SEC_DEBUG_IRQ_EXIT_LOG
	bool "Temporary Logging for IRQ delay"
	default n
	help
	  Verbose Logging for IRQ delay.

config SEC_DEBUG_AUXILIARY_LOG
	bool "Samsung Auxiliary Logging on noncached buf"
	default n
	help
	  This option enables sec_auxiliary_log support.
	  we can log repeated information insuitable for kernel log like DVFS
	  or power domain control information.
	  It can support non-cached auxiliary log in RAM dump and We don't
	  need to concern cache flush status for analyzing sudden
	  system hang issue.

config SEC_DEBUG_FUPLOAD_DUMP_MORE
	bool "Dump more information at forced upload"
	default n
	help
	  More information is printed out when a forced upload happens.
	  It uses customized dump functions instead of panic call.

config SEC_DEBUG_UMP_ALLOC_FAIL
	bool "Show warning message when UMP allcation fails"
	default n
	help
	  When UMP allocation fails there's no way to figure out the reason.
	  For UMP and Mali is supposed to allocate per 1 page,
	  we should take a good look at this failure.
	  This only shows the alloc fail warning.

config SEC_DEBUG_LIST_CORRUPTION
	bool "Panic when list corruption detected"
	default n
	help
	  Panic when list structure corruption detected.
	  Sometimes list corruptions are reported.
	  But it reports only with WARN level.
	  This will immediately stop the system.

menuconfig SEC_WATCHDOG_RESET
	bool "S5PV310 watchdog reset to exit from lockup"
	depends on (CPU_EXYNOS4210 || CPU_EXYNOS4212 || CPU_EXYNOS4412)
	default n
	help
	  Use watchdog reset to exit from lockup

if SEC_WATCHDOG_RESET
config SEC_WATCHDOG_PET_TIME
	int "sec watchdog kicking time interval value"
	default 5
endif

menuconfig SEC_DEBUG_INFORM
	bool "Samsung TN Ramdump information region on memory"
	default y
	help
	  Samsung TN Ramdump information region.

menuconfig SEC_DEBUG_INFORM_IOREMAP
	bool "Samsung TN Ramdump information region on memory"
	default n
	depends on SEC_DEBUG_INFORM
	help
	  Samsung TN Ramdump information region that is dynamically mapped by ioremap_nocache().

menuconfig SEC_DEBUG_INFORM_IOTABLE
	bool "Samsung TN Ramdump information region on memory"
	default y
	depends on SEC_DEBUG_INFORM
	help
	  Samsung TN Ramdump information region that is statically mapped by iotable_init().

endif 

config SEC_LOG
	default n
	bool "Enable support for sec_log" if EMBEDDED
	depends on PRINTK
	help
	  This option enables sec_log support. This provides combined
	  log buffer for both bootloader and kernel. It also preserves
	  previous content before reboot.

config SEC_LOG_NONCACHED
	default n
	bool "Enable non cached kernel sec_log support" if EMBEDDED
	depends on SEC_LOG
	help
	  This option enables sec_non_cached_klog support.  It can
	  support non-cached kernel log in RAM dump and We don't need
	  to concern cache flush status for analyzing sudden lockup
	  issue.

config SEC_LOG_LAST_KMSG
	default n
	bool "Enable /proc/last_kmsg support" if EMBEDDED
	depends on SEC_LOG
	help
	  This option enables /proc/last_kmsg support.
```

## arch/arm/mach-shmobile/ramdefrag/Kconfig
```kconfig
config SHMOBILE_RAM_DEFRAG
	bool
	depends on COMPACTION
	default n
	help
	  SH Mobile RAM Defrag feature
	  Get status of RAM banks whether they are used or freed
	  Execute RAM defragmentation for whole main memory
```

## drivers/accessory/Kconfig
```kconfig
#
# mhl drivers configuration
#

menu "Mhl(sii9244) device support"


config SAMSUNG_MHL
        bool "Enable Sii9244 MHL Chip Driver"
        default n
        ---help---
          support Sii9244 MHL Chip Driver

endmenu
```

## drivers/char/composer/Kconfig
```kconfig
#
# R_MOBILE config for  composer
#
#    support graphics image blending
#

config MISC_R_MOBILE_COMPOSER
	tristate "R-Mobile composer support"
	default y
	depends on MISC_R_MOBILE_COMPOSER_APPMEM_SHAREMANGER
	---help---
	  If Y is used, support of composer becomes effective.
	  and MISC_R_MOBILE_COMPOSER_APPMEM_SHAREMANGER is necessary.
	  Note:
	  This module can't modularize because there is unsolved dependence.

if MISC_R_MOBILE_COMPOSER
config MISC_R_MOBILE_COMPOSER_REQUEST_QUEUE
	bool "R-Mobile composer request queue support"
	depends on MISC_R_MOBILE_COMPOSER
	default y
	---help---
	  If Y is used, support of request queue interface becomes effective.
	  Note:
	  MISC_R_MOBILE_COMPOSER is necessary to enable this function.
endif

config MISC_R_MOBILE_COMPOSER_APPMEM_SHAREMANGER
	bool "R-Mobile APPMEM share manager"
	default y
	---help---
	  If Y is used, the function to share a APPMEM between kernel driver,
	  becomes effective.
	  Note:
	  This module can't modularize because there is unsolved dependence.
	  This function used MISC_R_MOBILE_COMPOSER or
	  VIDEO_R_MOBILE_V4L2OVERLAY.
```

## drivers/gpu/ion/Kconfig
```kconfig
menuconfig ION
	tristate "Ion Memory Manager"
	select GENERIC_ALLOCATOR
	select DMA_SHARED_BUFFER
	help
	  Chose this option to enable the ION Memory Manager.

config ION_TEGRA
	tristate "Ion for Tegra"
	depends on ARCH_TEGRA && ION
	help
	  Choose this option if you wish to use ion on an nVidia Tegra.

config ION_R_MOBILE
        tristate "Ion for R-Mobile"
        depends on ARCH_SHMOBILE && ION
        help
          Choose this option if you wish to use ion on Renesas R-Mobile.

config ION_R_MOBILE_USE_VIDEO_HEAP
	bool "Use video heap for secure contents"
	depends on ION_R_MOBILE
	default y
	help
	  Choose this option if you wish to use a video heap for secure
	  contents on Renesas R-Mobile.
```

## drivers/input/touchscreen/imagis/Kconfig
```kconfig
#
# Imagis Touchscreen driver configuration
#

source "drivers/input/touchscreen/imagis/gardalte/Kconfig"
source "drivers/input/touchscreen/imagis/loganlte/Kconfig"
source "drivers/input/touchscreen/imagis/afyonlte/Kconfig"
```

## drivers/input/touchscreen/zinitix/Kconfig
```kconfig
#
# ZINITIX Touchscreen driver configuration
#

source "drivers/input/touchscreen/zinitix/loganlte/Kconfig"
source "drivers/input/touchscreen/zinitix/afyonlte/Kconfig"
source "drivers/input/touchscreen/zinitix/lt02lte/Kconfig"
```

## drivers/input/touchscreen/zinitix/loganlte/Kconfig
```kconfig
#
# ZINITIX Touchscreen driver configuration
#

config TOUCHSCREEN_BT432
	tristate "ZINITIX touchscreen driver"
	depends on I2C
	help
	  Say Y here if you have a ZINITIX touchscreen.

	  If unsure, say N.
```

## drivers/mfd/richtek/Kconfig
```kconfig
#
# Richtek programmable micro USB switch drivers configuration
#
# Copyright (C) Richtek Corporation 2012
# Patrick Chang <patrick_chang@richtek.com>

config MFD_RT
	bool "Ricktek Multifunction Device Drivers"

	help
	  Say Y here, and a list of miscellaneous MUS drivers will be displayed.
	  Everything that didn't fit into the other categories is here. This option
	  doesn't affect the kernel.

	  If unsure, say Y.


if MFD_RT
menu "Richtek Multifunction Device Drivers"

config RT_I2C_MUSC
	bool "Use Richtek mUSB Switch Charger"
	depends on (I2C&&GPIOLIB)

choice
depends on RT_I2C_MUSC
prompt "MUS Charger Model"

config RT8969
	bool "RT8969"
	---help---
	RT8969
config RT8973
	bool "RT8973"
	---help---
	RT8973

endchoice


choice
depends on RT8969
prompt "Switch Control Mode"
depends on RT_I2C_MUSC
default RT8969_AUTO
config RT8969_CM_AUTO
	bool "Automatic"
config RT8969_CM_MANUAL
	bool "Manual"
endchoice

choice
depends on RT8973
prompt "Switch Control Mode"
depends on RT_I2C_MUSC
default RT8973_AUTO
config RT8973_CM_AUTO
	bool "Automatic"
config RT8973_CM_MANUAL
	bool "Manual"
endchoice

menu "RT8969 Setting"
depends on RT8969
source "drivers/mfd/richtek/RT8969Kconfig"
endmenu #RT8969 Setting

config RTMUSC_INT_CONFIG
depends on RT_I2C_MUSC
	bool "Configurate GPIO to be interrupt input pin"
	default y

config RTMUSC_INT_GPIO_NUMBER
depends on (RT_I2C_MUSC&&GPIOLIB)
	int "Used GPIO number"
	default "161"
	---help---
	Decimal number (See schematic of mainboard and SoC datasheet)

config RTMUSC_IRQ_NUMBER
depends on RT_I2C_MUSC
	int "IRQ number"
	default "-1"
	---help---
	Corresponding IRQ number.
	-1 means auto (use gpio_to_irq())

config RT_I2C_SMC
depends on (I2C&&GPIOLIB)
    bool "Richtek Switch Mode Charger"
    default y
    ---help---
    If unsure, choose y

choice
depends on RT_I2C_SMC
prompt "Switch mode charger model"
default RT9450
config RT9450AC
	bool "RT9450A/C"
	---help---
	RT9450A/C
config RT9450B
	bool "RT9450B"
	---help---
	RT9450B
config RT9451
	bool "RT9451"
	---help---
	RT9451
config RT9452
	bool "RT9452"
	---help---
	RT9452
config RT9453
	bool "RT9453"
	---help---
	RT9453
endchoice

if RT9450AC || RT9450B
menu "RT9450 Setting"
source "drivers/mfd/richtek/RT9450Kconfig"
endmenu
endif

config RTSMC_INT_CONFIG
depends on RT_I2C_SMC
	bool "Configurate GPIO to be interrupt input pin"
	default y

config RTSMC_INT_GPIO_NUMBER
depends on (RT_I2C_SMC&&GPIOLIB)
	int "Used GPIO number"
	default "161"
	---help---
	Decimal number (See schematic of mainboard and SoC datasheet)

config RTSMC_IRQ_NUMBER
depends on RT_I2C_SMC
	int "IRQ number"
	default "-1"
	---help---
	Corresponding IRQ number.
	-1 means auto (use gpio_to_irq())


config RT_SYSFS_DBG
    bool "Enable Richtek Multifunction Device Driver Engineering Debug/Tuning Mode"
    depends on MFD_RT
    default y
    ---help---
    Provide serveral nodes to debug/tune performance or calbriate.
    It will be mounted on /sys/devices/platform/rtmus/debug

config RT_SHOW_INFO
    bool "Show Debug Info"
    default y
    ---help---
    For debug

endmenu #Richtek MUS
endif # RT_I2C_MUSC
```

## drivers/motor/Kconfig
```kconfig
#
#
#
menuconfig VIBETONZ
	tristate "Vibetonz"
	default n
	help
	  Say Y to enable Vibetonz support.

config MOTOR_DRV_MAX77693
	tristate "Maxim MAX77693 motor"
	default n
	depends on MFD_MAX77693
	help
	  If you say yes here you will get support for the
	  motor of Maxim MAX77693 PMIC.

config MOTOR_DRV_MAX8997
	tristate "Maxim MAX8997 motor"
	default n
	depends on MFD_MAX8997
	help
	  If you say yes here you will get support for the
	  motor of Maxim MAX8997 PMIC.

config MOTOR_DRV_ISA1200
	tristate "ISA1200 motor"
	default n
	depends on I2C
	help
	  Say Y to enalbe the ISA1200 IC.

config VIBRATOR_ISA1000A
	tristate "ISA1000a motor"
	default n
	help
	  Say Y to enalbe the ISA1000a IC.

config VIBRATOR_SS
	tristate "SS motor"
	default n
	help
	  Say Y to enalbe the coil motor
	  
```

## drivers/pmic/Kconfig
```kconfig
menuconfig PMIC_INTERFACE
	tristate "PowerManagement IC interface support"
	help
	  This enables support for the PowerManagement IC interface.
	  This feature inclue power control management.
	  and battery control management.

if PMIC_INTERFACE
config USB_OTG_INTERFACE
	bool "USB-OTG IC interface support"
	default n
	help
	  This enables support for the USB-OTG interface.
	  This feature control power supply for USB OTG.
	  device via PMIC.
	  (supply 5V).

config PMIC_TPS80032_POW
	bool "TPS80032 Power Department Support"
	default n
	help
	  This enables support for the Power Department interface.
	  This feature is not belong to PMIC driver.
	  It's dependecy driver.

config PMIC_NCP6914_POW
	bool "NCP6914 Power Department Support"
	default m
	help
	  This enables support for the Power Department interface.
	  This feature is not belong to PMIC driver.
	  It's dependecy driver.

endif # PMIC_INTERFACE
```

## drivers/sec_hal/Kconfig
```kconfig
#
# SEC_HAL Linux Kernel Module Configuration file
config ARM_SEC_HAL
	bool "ARM trustzone (TZ) access hardware abstraction layer."
	default n
#	depends ARM
	---help---
	ARM trustzone (TZ) access hardware abstraction layer.

config ARM_SEC_HAL_DRM_WVN
	bool "Enable sec_hal widevine drm implementation."
	default n
#	depends ARM_SEC_HAL
	---help---
	Enable sec_hal widevine drm implementation.

config ARM_SEC_HAL_TEE
	bool "Enable sec_hal trusted execution environment support"
	default n
#	depends ARM_SEC_HAL
	---help---
	Enable sec_hal widevine drm implementation.


if ARM_SEC_HAL
# RND conf flags to enable early integration. Consider removing asap.

config ARM_SEC_HAL_TRACE
	bool "Use printk to trace execution.(monitoring)"
	default n
#	depends ARM_SEC_HAL
	---help---
	Use printk to trace execution.(monitoring). Useful when integrating to hw.

config ARM_SEC_HAL_TEST_DISPATCHER
	bool "Use test dispatcher instead of real one."
	default n
#	depends ARM_SEC_HAL
	---help---
	Use test dispatcher instead of real one.

config ARM_SEC_HAL_SDTOC
	bool "Read data from sdram toc instead of using secure services."
	default n
#	depends ARM_SEC_HAL
	---help---
	Read data from sdram toc instead of using secure services.

endif
```

## drivers/sh/Kconfig
```kconfig
menu "SuperH / SH-Mobile Driver Options"

source "drivers/sh/intc/Kconfig"

endmenu

config RENESAS_DUMMY_NETDEV
	bool "Renesas dummy net device"
	depends on ARCH_SHMOBILE
	default n
	help
	  This enables support for dummy network device support for renesas.
	  If in doubt, say N.

config RENESAS_MDMLOADER
	bool "Renesas MODEM driver loader"
	depends on ARCH_SHMOBILE
	default n
	help
	  This enables support for modem software loader support for renesas boards.
	  If in doubt, say N.
```
